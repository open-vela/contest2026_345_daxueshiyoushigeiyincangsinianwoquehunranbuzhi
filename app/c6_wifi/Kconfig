## app/c6_wifi/Kconfig
```kconfig
#
# Contest 2026 team 345 ESP32-C6 Wi-Fi link utility
#

config LVX_USE_DEMO_CONTEST2026_345_C6_WIFI
	bool "Contest 2026 team 345 ESP32-C6 Wi-Fi link utility"
	default n
	depends on CONTEST2026_345_C6_WIFI
	---help---
		Enable the c6_wifi command used to probe the on-board ESP32-C6
		SDIO link without blocking NSH during board initialization.
```

## board/contest_board/Kconfig
```kconfig
#
# Contest 2026 team 345 ESP32-P4X Function EV Board
#

if ARCH_CHIP_ESP32P4

config CONTEST2026_345_BOARD_TAG
	string
	default "esp32p4x-function-ev-board"

config CONTEST2026_345_C6_WIFI
	bool "ESP32-C6 Hosted Wi-Fi over SDIO"
	depends on ESP32P4_SDMMC
	default n
	---help---
		Enable the on-board ESP32-C6-MINI-1 wireless co-processor on
		SDMMC slot 1.  GPIO54 controls C6_EN and GPIO6 is reserved for
		C6_WAKEUP.  The SDIO bus uses GPIO14 through GPIO19.

config CONTEST2026_345_C6_WIFI_AUTOINIT
	bool "Probe ESP32-C6 during board initialization"
	depends on CONTEST2026_345_C6_WIFI
	default n
	---help---
		Run the SDIO link probe before NSH starts.  Keep this disabled while
		bringing up the transport so a failed probe cannot hide the console.

config ESPRESSIF_SPIFLASH_AUTO_BRINGUP
	bool "Automatic mount of SPI Flash MTD"
	depends on ESPRESSIF_MTD
	default y

choice ESPRESSIF_SPIFLASH_FS
	prompt "File system to mount on SPI Flash MTD"
	default ESPRESSIF_SPIFLASH_SMARTFS
	depends on ESPRESSIF_SPIFLASH_AUTO_BRINGUP
	optional

config ESPRESSIF_SPIFLASH_SMARTFS
	bool "SmartFS"
	select FS_SMARTFS
	select MTD_SMART

endchoice # ESPRESSIF_SPIFLASH_FS

config ESPRESSIF_SPIFLASH_FS_MOUNT_PT
	string "SPI Flash SmartFS mount point"
	depends on ESPRESSIF_SPIFLASH_SMARTFS
	default "/data"

endif
```

## board/contest_board/configs/camera/defconfig
```kconfig
#
# ESP32-P4X Function EV Board V1.8 camera/DW-GDMA isolation config
#
# CONFIG_ESPRESSIF_UART0 is not set
# CONFIG_NSH_ARGCAT is not set
# CONFIG_NSH_CMDOPT_HEXDUMP is not set
CONFIG_ARCH="risc-v"
CONFIG_ARCH_BOARD_CUSTOM=y
CONFIG_ARCH_BOARD_CUSTOM_DIR="../vendor/openvela/boards/contest2026_345_board"
CONFIG_ARCH_BOARD_CUSTOM_DIR_RELPATH=y
CONFIG_ARCH_BOARD_CUSTOM_NAME="esp32p4x-function-ev-board"
CONFIG_ARCH_CHIP="esp32p4"
CONFIG_ARCH_CHIP_ESP32P4=y
CONFIG_ARCH_INTERRUPTSTACK=2048
CONFIG_ARCH_IRQ_TO_NDX=y
CONFIG_ARCH_MINIMAL_VECTORTABLE_DYNAMIC=y
CONFIG_ARCH_NUSER_INTERRUPTS=17
CONFIG_ARCH_RISCV=y
CONFIG_BOARDCTL_RESET=y
CONFIG_BOARD_LOOPSPERMSEC=15000
CONFIG_BUILTIN=y
CONFIG_ESP32P4_MIPI_CSI=y
CONFIG_ESPRESSIF_FLASH_16M=y
CONFIG_ESPRESSIF_I2C0=y
CONFIG_ESPRESSIF_I2C0_SCLPIN=8
CONFIG_ESPRESSIF_I2C0_SDAPIN=7
CONFIG_ESPRESSIF_SPIRAM=y
CONFIG_ESPRESSIF_USBSERIAL=y
CONFIG_EXPERIMENTAL=y
CONFIG_I2CTOOL_DEFFREQ=100000
CONFIG_I2CTOOL_MAXBUS=0
CONFIG_IDLETHREAD_STACKSIZE=2048
CONFIG_INIT_ENTRYPOINT="nsh_main"
CONFIG_LIBC_PERROR_STDOUT=y
CONFIG_LIBC_STRERROR=y
CONFIG_LVX_USE_DEMO_CONTEST2026_345_SC2336_PROBE=y
# CONFIG_LVX_USE_DEMO_CONTEST2026_345_VELAFIT_AI is not set
CONFIG_MM_KERNEL_HEAP=y
CONFIG_MM_REGIONS=2
CONFIG_NFILE_DESCRIPTORS_PER_BLOCK=6
CONFIG_NSH_ARCHINIT=y
CONFIG_NSH_BUILTIN_APPS=y
CONFIG_NSH_FILEIOSIZE=512
CONFIG_NSH_READLINE=y
CONFIG_NSH_STRERROR=y
CONFIG_PREALLOC_TIMERS=0
CONFIG_RISCV_TOOLCHAIN_GNU_RV32=y
CONFIG_RR_INTERVAL=200
CONFIG_SCHED_BACKTRACE=y
CONFIG_SCHED_HPWORK=y
CONFIG_SCHED_WAITPID=y
CONFIG_START_DAY=29
CONFIG_START_MONTH=11
CONFIG_START_YEAR=2019
CONFIG_SYSTEM_DUMPSTACK=y
CONFIG_SYSTEM_I2CTOOL=y
CONFIG_SYSTEM_NSH=y
```
